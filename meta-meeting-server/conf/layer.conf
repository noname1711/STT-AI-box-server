## meta-meeting-server/conf/layer.conf
```bitbake
BBPATH .= ":${LAYERDIR}"

BBFILES += " \
    ${LAYERDIR}/recipes-*/*/*.bb \
    ${LAYERDIR}/recipes-*/*/*.bbappend \
"

BBFILE_COLLECTIONS += "meetingserver"
BBFILE_PATTERN_meetingserver = "^${LAYERDIR}/"
BBFILE_PRIORITY_meetingserver = "10"

LAYERDEPENDS_meetingserver = "core openembedded-layer meta-python tegrademo"
LAYERSERIES_COMPAT_meetingserver = "scarthgap"
```
